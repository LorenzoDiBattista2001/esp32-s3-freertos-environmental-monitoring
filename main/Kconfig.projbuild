## main/Kconfig.projbuild
```kconfig
menu "Custom Wi-Fi Configuration"

    config WIFI_SSID
        string "WiFi SSID"
        default "DEFAULT_SSD"
        help
            SSID of the Wi-Fi network to connect to.

    config WIFI_PASSWORD
        string "WiFi Password"
        default "DEFAULT_PASSWORD"
        help
            Password of the Wi-Fi network to connect to.

    config MAXIMUM_RETRY
        int "Maximum retry"
        default 5
        help
            Maximum number of connection retries.

endmenu

menu "Custom MQTT Configuration"
    
    config BROKER_URL
        string "MQTT Broker URI"
        default "DEFAULT_BROKER_URI"
        help
            The complete URI of MQTT Broker

    config CLIENT_USERNAME
        string "MQTT Client username"
        default "DEFAULT_USERNAME"
        help
            Username used for connecting to the broker

    config CLIENT_PASSWORD
        string "MQTT Client password"
        default "DEFAULT_PASSWORD"
        help
            Password to authenticate client

    config TOPIC_STRING
        string "Topic String"
        default "default/topic"
        help
            MQTT topic to subscribe or publish data to
endmenu
```
